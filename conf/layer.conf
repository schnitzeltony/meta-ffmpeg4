## conf/layer.conf
```bitbake
# We have a conf and classes directory, append to BBPATH
BBPATH .= ":${LAYERDIR}"

BBFILES += "${LAYERDIR}/recipes-ffmpeg/ffmpeg4_4.4.1.bb"

BBFILE_COLLECTIONS += "ffmpeg4-layer"
BBFILE_PATTERN_ffmpeg4-layer := "^${LAYERDIR}/"
BBFILE_PRIORITY_ffmpeg4-layer = "7"

LAYERDEPENDS_ffmpeg4-layer = " \
    core \
"

LAYERSERIES_COMPAT_ffmpeg4-layer = "kirkstone"
```
